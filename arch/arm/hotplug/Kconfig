## arch/arm/hotplug/Kconfig
```kconfig
# Kconfig file for hotplugs

config ALUCARD_HOTPLUG
	bool "Enable alucard-hotplug cpu hotplug driver"
	depends on HOTPLUG_CPU
	default y
	help
	  Generic Alucard-hotplug cpu hotplug driver for ARM SOCs

config DYNAMIC_HOTPLUG
	bool "Enable dynamic-hotplug cpu hotplug driver"
	default y
	help
	  Generic Dynamic-hotplug cpu hotplug driver for ARM SOCs

config BLU_PLUG
	bool "Dynamic hotplug driver"
	depends on HOTPLUG_CPU
	default n
	help
	  The Dynamic hotplug driver automatically online/offline CPUs proportional to system load.

config BRICKED_HOTPLUG
	bool "Enable kernel based mpdecision"
	depends on MSM_SMP && MSM_DCVS && HOTPLUG_CPU
	default n
	help
	  This enables kernel based multi core control.
	  (up/down hotplug based on load)

config ASMP
	bool "Multi-core automatic hotplug support"
        depends on SMP && HOTPLUG_CPU
        default n
        help
          Automatically hotplugs the multiple cpu cores on and off
          based on cpu load and suspend state
 
config LAZYPLUG
	bool "Conservative hotplugging for generic devices"
	depends on HOTPLUG_CPU && MSM_RUN_QUEUE_STATS_BE_CONSERVATIVE
	default n
	help
	  This enables the conservative hotplugging, lazyplug by arter97
	  based on intelli_plug. Refer to the comments for more info.

config MSM_SLEEPER
	bool "CPU hotplug driver"
	default y
	help
	  CPU hotplug driver

config STATE_HELPER
        bool "State Helper"
	depends on STATE_NOTIFIER

config THUNDER_PLUG
	bool "Enable plugging down/up of cores using powersuspend"
	depends on HOTPLUG_CPU
	help
       This driver uses powersuspend to take down the cpu cores
       on a octa core device. Tuned to work on a dual core device.
```
