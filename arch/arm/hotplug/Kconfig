## drivers/cpufreq/Kconfig
```kconfig
menu "CPU Frequency scaling"

config CPU_FREQ
	bool "CPU Frequency scaling"
	help
	  CPU Frequency scaling allows you to change the clock speed of 
	  CPUs on the fly. This is a nice method to save power, because 
	  the lower the CPU clock speed, the less power the CPU consumes.

	  Note that this driver doesn't automatically change the CPU
	  clock speed, you need to either enable a dynamic cpufreq governor
	  (see below) after boot, or use a userspace tool.

	  For details, take a look at <file:Documentation/cpu-freq>.

	  If in doubt, say N.

if CPU_FREQ

config CPU_FREQ_TABLE
	tristate

config INTERACTION_HINTS
	bool "Provide interaction hints to governors"
	default y
 
config CPU_FREQ_DVFS_MONITOR
	bool "dvfs monitor"
	depends on CPU_FREQ
	help
	  This option adds a proc node for dvfs monitoring.
	  /proc/dvfs_mon

config CPU_FREQ_STAT
	tristate "CPU frequency translation statistics"
	select CPU_FREQ_TABLE
	default y
	help
	  This driver exports CPU frequency statistics information through sysfs
	  file system.

	  To compile this driver as a module, choose M here: the
	  module will be called cpufreq_stats.

	  If in doubt, say N.

config CPU_FREQ_STAT_DETAILS
	bool "CPU frequency translation statistics details"
	depends on CPU_FREQ_STAT
	help
	  This will show detail CPU frequency translation table in sysfs file
	  system.

	  If in doubt, say N.

config CPU_FREQ_LIMIT
	tristate "CPU frequency limits"
	depends on MSM_CPU_FREQ_SET_MIN_MAX
	help
	  This driver allows userspace to limit the CPU frequency through sysfs
	  file system.

	  To compile this driver as a module, choose M here: the
	  module will be called cpufreq_stats.

	  If in doubt, say N.

config CPU_BOOST_DRIVER
	bool "CPU frequency boost driver"
	help
	  A battery-hungry hydra: cut one touch booster off, two more grow back
	  in its place.  This one is particularly vicious: it's even more
	  aggressive, and it breaks CPU hotplugging.

choice
	prompt "Default CPUFreq governor"
	default CPU_FREQ_DEFAULT_GOV_USERSPACE if CPU_FREQ_SA1100 || CPU_FREQ_SA1110
	default CPU_FREQ_DEFAULT_GOV_PERFORMANCE
	help
	  This option sets which CPUFreq governor shall be loaded at
	  startup. If in doubt, select 'performance'.

config CPU_FREQ_DEFAULT_GOV_ALUCARD
	bool "alucard"
	select CPU_FREQ_GOV_ALUCARD
	help

config CPU_FREQ_DEFAULT_GOV_BLU_ACTIVE
	bool "blu_active"
	select CPU_FREQ_GOV_BLU_ACTIVE
	help
	  Use the CPUFreq governor 'blu_active' as default. This allows
	  you to get a full dynamic cpu frequency capable system by simply
	  loading your cpufreq low-level hardware driver, using the
	  'interactive' governor for latency-sensitive workloads.

config CPU_FREQ_DEFAULT_GOV_CHILL
	bool "chill"
	select CPU_FREQ_GOV_CHILL
	select CPU_FREQ_GOV_INTERACTIVE
	help
	  Use the CPUFreq governor 'chill' as default. This allows
	  you to get a full dynamic frequency capable system by simply
	  loading your cpufreq low-level hardware driver.
	  Be aware that not all cpufreq drivers support the conservative
	  governor. If unsure have a look at the help section of the
	  driver. Fallback governor will be the interactive governor.

config CPU_FREQ_DEFAULT_GOV_CONSERVATIVE
	bool "conservative"
	select CPU_FREQ_GOV_CONSERVATIVE
	select CPU_FREQ_GOV_PERFORMANCE
	help
	  Use the CPUFreq governor 'conservative' as default. This allows
	  you to get a full dynamic frequency capable system by simply
	  loading your cpufreq low-level hardware driver.
	  Be aware that not all cpufreq drivers support the conservative
	  governor. If unsure have a look at the help section of the
	  driver. Fallback governor will be the performance governor.

config CPU_FREQ_DEFAULT_GOV_CULTIVATION
	bool "cultivation"
	select CPU_FREQ_GOV_CULTIVATION
	help
	Use the CPUFreq governor 'cultivation' as default.

config CPU_FREQ_DEFAULT_GOV_CYAN
	bool "cyan"
	select CPU_FREQ_GOV_INTERACTIVE
	help
	  Use the CPUFreq governor 'cyan' as default. This allows
	  you to get a full dynamic frequency capable system by simply
	  loading your cpufreq low-level hardware driver.
	  Be aware that not all cpufreq drivers support the cyan
	  governor. If unsure have a look at the help section of the
	  driver. Fallback governor will be the interactive governor.

config CPU_FREQ_DEFAULT_GOV_DARKNESS
	bool "darkness"
	select CPU_FREQ_GOV_DARKNESS
	help

config CPU_FREQ_DEFAULT_GOV_DESPAIR
	bool "despair"
	select CPU_FREQ_GOV_DESPAIR
	help

config CPU_FREQ_DEFAULT_GOV_ELEMENTALX
	bool "despair"
	select CPU_FREQ_GOV_ELEMENTALX
	help

config CPU_FREQ_DEFAULT_GOV_FREELUNCH
	bool "freelunch"
	select CPU_FREQ_GOV_FREELUNCH

config CPU_FREQ_DEFAULT_GOV_INTERACTIVE
	bool "interactive"
	select CPU_FREQ_GOV_INTERACTIVE
	help
	  Use the CPUFreq governor 'interactive' as default. This allows
	  you to get a full dynamic cpu frequency capable system by simply
	  loading your cpufreq low-level hardware driver, using the
	  'interactive' governor for latency-sensitive workloads.

config CPU_FREQ_DEFAULT_GOV_LIONFISH
	bool "lionfish"
	select CPU_FREQ_GOV_LIONFISH
	help
	  Use the CPUFreq governor 'lionfish' as default.

config CPU_FREQ_DEFAULT_GOV_NIGHTMARE
	bool "nightmare"
	select CPU_FREQ_GOV_NIGHTMARE
	help

config CPU_FREQ_DEFAULT_GOV_ONDEMAND
	bool "ondemand"
	select CPU_FREQ_GOV_ONDEMAND
	select CPU_FREQ_GOV_PERFORMANCE
	help
	  Use the CPUFreq governor 'ondemand' as default. This allows
	  you to get a full dynamic frequency capable system by simply
	  loading your cpufreq low-level hardware driver.
	  Be aware that not all cpufreq drivers support the ondemand
	  governor. If unsure have a look at the help section of the
	  driver. Fallback governor will be the performance governor.

config CPU_FREQ_DEFAULT_GOV_PERFORMANCE
	bool "performance"
	select CPU_FREQ_GOV_PERFORMANCE
	help
	  Use the CPUFreq governor 'performance' as default. This sets
	  the frequency statically to the highest frequency supported by
	  the CPU.

config CPU_FREQ_DEFAULT_GOV_POWERSAVE
	bool "powersave"
	depends on EXPERT
	select CPU_FREQ_GOV_POWERSAVE
	help
	  Use the CPUFreq governor 'powersave' as default. This sets
	  the frequency statically to the lowest frequency supported by
	  the CPU.

config CPU_FREQ_DEFAULT_GOV_RELAXED
	bool "relaxed"
	select CPU_FREQ_GOV_RELAXED
	select CPU_FREQ_GOV_INTERACTIVE
	help
	  Use the CPUFreq governor 'relaxed' as default. This allows
	  you to get a full dynamic frequency capable system by simply
	  loading your cpufreq low-level hardware driver.
	  Be aware that not all cpufreq drivers support the conservative
	  governor. If unsure have a look at the help section of the
	  driver. Fallback governor will be the interactive governor.

config CPU_FREQ_DEFAULT_GOV_SKATERACTIVE
	bool "skateractive"
	select CPU_FREQ_GOV_SKATERACTIVE
	help
	  Use the CPUFreq governor 'skateractive' as default. This allows
	  you to get a full dynamic cpu frequency capable system by simply
	  loading your cpufreq low-level hardware driver, using the
	  'skateractive' governor for latency-sensitive workloads.

config CPU_FREQ_DEFAULT_GOV_SKATTER_CORE
	bool "skatter_core"
	select CPU_FREQ_GOV_SKATTER_CORE
	help
	  Frequency governor 'umbrella_core' heavily modified for D2 devices
          Renamed as 'skatter_core'
	  Use the CPUFreq governor 'skatter_core' as default. This allows
	  you to get a full dynamic cpu frequency capable system by simply
	  loading your cpufreq low-level hardware driver, using the
	  'skatter_core' governor for latency-sensitive workloads.

config CPU_FREQ_DEFAULT_GOV_SMARTMAX
        bool "smartmax"
        select CPU_FREQ_GOV_SMARTMAX
        help
          Use the CPUFreq governor 'smartmax' as default

config CPU_FREQ_DEFAULT_GOV_SMARTMAX_EPS
        bool "smartmax_eps"
        select CPU_FREQ_GOV_SMARTMAX_EPS
        help
          Use the CPUFreq governor 'smartmax eps' as default

config CPU_FREQ_DEFAULT_GOV_TIERSERVATIVE
	bool "tierservative"
	select CPU_FREQ_GOV_TIERSERVATIVE
	select WMAVG
	help
	  Here be dragons.

config CPU_FREQ_DEFAULT_GOV_USERSPACE
	bool "userspace"
	select CPU_FREQ_GOV_USERSPACE
	help
	  Use the CPUFreq governor 'userspace' as default. This allows
	  you to set the CPU frequency manually or when a userspace 
	  program shall be able to set the CPU dynamically without having
	  to enable the userspace governor manually.

endchoice

config CPU_FREQ_GOV_ALUCARD
	tristate "'alucard' cpufreq governor"
	depends on CPU_FREQ

config CPU_FREQ_GOV_BLU_ACTIVE
	tristate "'blu_active' cpufreq policy governor"
	help
	  'blu_active' - This driver adds a dynamic cpufreq policy governor
	  designed for latency-sensitive workloads.

config CPU_FREQ_GOV_CHILL
	tristate "'chill' cpufreq governor"
	depends on CPU_FREQ
	default y
	help
	  'chill' - similar to 'conservative', but optimized for devices
	  that go into suspended or display off states often.

config CPU_FREQ_GOV_CONSERVATIVE
	tristate "'conservative' cpufreq governor"
	depends on CPU_FREQ
	help
	  'conservative' - this driver is rather similar to the 'ondemand'
	  governor both in its source code and its purpose, the difference is
	  its optimisation for better suitability in a battery powered
	  environment.  The frequency is gracefully increased and decreased
	  rather than jumping to 100% when speed is required.

	  If you have a desktop machine then you should really be considering
	  the 'ondemand' governor instead, however if you are using a laptop,
	  PDA or even an AMD64 based computer (due to the unacceptable
	  step-by-step latency issues between the minimum and maximum frequency
	  transitions in the CPU) you will probably want to use this governor.

	  To compile this driver as a module, choose M here: the
	  module will be called cpufreq_conservative.

	  For details, take a look at linux/Documentation/cpu-freq.

	  If in doubt, say N.

config CPU_FREQ_GOV_CULTIVATION
	tristate "'cultivation' cpufreq governor"
	depends on CPU_FREQ
	help
	  'cultivation' - another tuned interactive with extra options

config CPU_FREQ_GOV_CYAN
	tristate "'cyan' cpufreq governor"
	depends on CPU_FREQ
	help
	  'cyan' - governor based on interactive
	  Modified for heavy gaming.

config CPU_FREQ_GOV_DARKNESS
	tristate "'darkness' cpufreq governor"
	depends on CPU_FREQ

config CPU_FREQ_GOV_DESPAIR
	tristate "'despair' cpufreq governor"
	depends on CPU_FREQ

config CPU_FREQ_GOV_ELEMENTALX
	tristate "'elementalx' cpufreq policy governor"
	select CPU_FREQ_TABLE

config CPU_FREQ_GOV_FREELUNCH
	tristate "'freelunch' cpufreq governor"
	depends on CPU_FREQ && INTERACTION_HINTS

config CPU_FREQ_GOV_INTELLIACTIVE
	tristate "'intelliactive' cpufreq policy governor"
	default y
	select CPU_FREQ_TABLE

config CPU_FREQ_GOV_INTERACTIVE
	tristate "'interactive' cpufreq policy governor"
	help
	  'interactive' - This driver adds a dynamic cpufreq policy governor
	  designed for latency-sensitive workloads.

	  This governor attempts to reduce the latency of clock
	  increases so that the system is more responsive to
	  interactive workloads.

	  To compile this driver as a module, choose M here: the
	  module will be called cpufreq_interactive.

	  For details, take a look at linux/Documentation/cpu-freq.

	  If in doubt, say N.

config CPU_FREQ_GOV_LIONFISH
	tristate "'lionfish' governor"
	depends on CPU_FREQ
	help
	  'lionfish' - this is an improved version of the conservative governor
	  that is optimized for smartphones. To avoid lag, it quickly jumps
	  to an intermediate frequency when high load is encountered at low
	  frequencies. If very high load is encountered above this intermediate
	  frequency, it jumps to a high frequency. For moderate loads, it
	  votes to increase, decrease, or maintain frequencies at each sampling
	  interval. When enough votes are gathered to raise or lower the
	  frequency, the frequency is changed. This mechanism reduces jitter
	  compared to the conservative governor. Lionfish uses proportional
	  ramping to more quickly reach suitable frequencies compared to the
	  conservative governor. By default, Lionfish also reduces frequencies
	  more aggressively than the conservative governor when loads are reduced.

	  To compile this driver as a module, choose M here: the
	  module will be called cpufreq_lionfish.

	  If in doubt, say N.

config CPU_FREQ_GOV_NIGHTMARE
	tristate "'nightmare' cpufreq governor"
	depends on CPU_FREQ

config CPU_FREQ_GOV_ONDEMAND
	tristate "'ondemand' cpufreq policy governor"
	select CPU_FREQ_TABLE
	help
	  'ondemand' - This driver adds a dynamic cpufreq policy governor.
	  The governor does a periodic polling and 
	  changes frequency based on the CPU utilization.
	  The support for this governor depends on CPU capability to
	  do fast frequency switching (i.e, very low latency frequency
	  transitions). 

	  To compile this driver as a module, choose M here: the
	  module will be called cpufreq_ondemand.

	  For details, take a look at linux/Documentation/cpu-freq.

	  If in doubt, say N.

config CPU_FREQ_GOV_PERFORMANCE
	tristate "'performance' governor"
	help
	  This cpufreq governor sets the frequency statically to the
	  highest available CPU frequency.

	  To compile this driver as a module, choose M here: the
	  module will be called cpufreq_performance.

	  If in doubt, say Y.

config CPU_FREQ_GOV_POWERSAVE
	tristate "'powersave' governor"
	help
	  This cpufreq governor sets the frequency statically to the
	  lowest available CPU frequency.

	  To compile this driver as a module, choose M here: the
	  module will be called cpufreq_powersave.

	  If in doubt, say Y.

config CPU_FREQ_GOV_RELAXED
	tristate "'relaxed' cpufreq governor"
	depends on CPU_FREQ
	default y
	help
	  'relaxed' - similar to 'conservative', but optimized for devices
	  that go into suspended or display off states often.

config CPU_FREQ_GOV_SKATERACTIVE
	tristate "'skateractive' cpufreq policy governor"
	help
	  'skateractive' - This driver adds a dynamic cpufreq policy governor
	  designed for latency-sensitive workloads.
	  This governor is a full backport of the 3.10.y "interactive" governor
	  with many modifications and cleaned out all code that wasn't needed
          it has ability to triple timer_rate on screen off and user can set max
          frequency on screen off.

config CPU_FREQ_GOV_SKATTER_CORE
	tristate "'skatter_core' cpufreq policy governor"
 	help
	  'skatter_core' - This driver adds a dynamic cpufreq policy governor
	  designed for latency-sensitive workloads.
	  The governor is based on interactive to provide a resident controller
	  which interprets unnecessary battery drain as evil

config CPU_FREQ_GOV_SMARTMAX
        tristate "'smartmax' cpufreq policy governor"
        select CPU_FREQ_TABLE
        help
          'smartmax' combined ondemand and smartass2

config CPU_FREQ_GOV_SMARTMAX_EPS
        tristate "'smartmax EPS' cpufreq policy governor"
        select CPU_FREQ_TABLE
        help
          'smartmax EPS' is the extreme powersaving version of smartmax

config CPU_FREQ_GOV_TIERSERVATIVE
	tristate "'tierservative' cpufreq governor"
	depends on CPU_FREQ
	select WMAVG
	help
	  Here be dragons.

config CPU_FREQ_GOV_USERSPACE
	tristate "'userspace' governor for userspace frequency scaling"
	help
	  Enable this cpufreq governor when you either want to set the
	  CPU frequency manually or when a userspace program shall
	  be able to set the CPU dynamically, like on LART 
	  <http://www.lartmaker.nl/>.

	  To compile this driver as a module, choose M here: the
	  module will be called cpufreq_userspace.

	  For details, take a look at <file:Documentation/cpu-freq/>.

	  If in doubt, say Y.

menu "x86 CPU frequency scaling drivers"
depends on X86
source "drivers/cpufreq/Kconfig.x86"
endmenu

menu "ARM CPU frequency scaling drivers"
depends on ARM
source "drivers/cpufreq/Kconfig.arm"
endmenu

menu "PowerPC CPU frequency scaling drivers"
depends on PPC32 || PPC64
source "drivers/cpufreq/Kconfig.powerpc"
endmenu

endif
endmenu
```
