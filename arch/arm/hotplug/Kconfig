## fs/exfat/Kconfig
```kconfig
config EXFAT_FS
	tristate "exFAT file system support"
	default n
	select NLS
	select NLS_UTF8
	help
	  If you want to use the exFAT file systems, then you must say Y or M here
	  to inlucde exFAT support. 
```
